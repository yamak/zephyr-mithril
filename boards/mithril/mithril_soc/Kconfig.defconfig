## boards/mithril/mithril_soc/Kconfig.mithril_soc
```kconfig
# Copyright (c) 2025 Yusuf Yamak <yamakyusuf@gmail.com>
# SPDX-License-Identifier: Apache-2.0

config BOARD_MITHRIL_SOC
	select SOC_MITHRIL
```

## boards/mithril/mithril_soc/mithril_soc_defconfig
```kconfig
# Copyright (c) 2025 Yusuf Yamak <yamakyusuf@gmail.com>
# SPDX-License-Identifier: Apache-2.0

CONFIG_CONSOLE=y
CONFIG_SERIAL=y
CONFIG_UART_CONSOLE=y
CONFIG_GPIO=y
CONFIG_CLOCK_CONTROL=n
CONFIG_XIP=n
CONFIG_INSTR_MEM_SIZE=200
CONFIG_DATA_MEM_SIZE=150
CONFIG_RISCV_MACHINE_TIMER=y
```

## drivers/crypto/Kconfig.mithril
```kconfig
# Copyright (c) 2025, Yusuf Yamak <yamakyusuf@gmail.com>
# SPDX-License-Identifier: Apache-2.0

config CRYPTO_MITHRIL_DSEE_SHA
	bool "Mithril DSEE SHA Driver"
	default y
	depends on DT_HAS_MITHRIL_DSEE_HASH_ENABLED
    select USE_MITHRIL_HAL_DSEE_HASH
	help
	  This option enables the Mithril DSEE Hash Engine driver.
```

## drivers/entropy/Kconfig.mithril
```kconfig
# Copyright (c) 2025 Yusuf Yamak <yamakyusuf@gmail.com>
# SPDX-License-Identifier: Apache-2.0

menuconfig ENTROPY_MITHRIL_TRNG
	bool "Mithril TRNG driver"
	default y
	depends on DT_HAS_MITHRIL_TRNG_ENABLED
	select USE_MITHRIL_HAL_TRNG
	select RING_BUFFER
	select ENTROPY_HAS_DRIVER

if ENTROPY_MITHRIL_TRNG

config ENTROPY_MITHRIL_TRNG_ISR_POOL_SIZE
	int "Buffer size for ISR-mode random number generation"
	default 16
	help
	  Specifies the size (in bytes) of the buffer that stores hardware-generated
	  entropy data for interrupt service routine (ISR) consumers.
	  Note: The pool size must be a power of 2.

config ENTROPY_MITHRIL_TRNG_ISR_THRESHOLD
	int "Minimum threshold for ISR-mode random number buffer"
	range 4 $(UINT8_MAX)
	help
	  The minimum number of bytes that triggers entropy generation for
	  interrupt service routine (ISR) consumers. The hardware will start
	  generating new entropy data when the available bytes in the buffer
	  fall below this threshold value.

config ENTROPY_MITHRIL_TRNG_THR_POOL_SIZE
	int "Buffer size for thread-mode random number generation"
	default 8
	help
	  Specifies the size (in bytes) of the buffer that stores hardware-generated
	  entropy data for thread mode consumers.
	  Note: The pool size must be a power of 2.

config ENTROPY_MITHRIL_TRNG_THR_THRESHOLD
	int "Minimum threshold for thread-mode random number buffer"
	range 4 $(UINT8_MAX)
	help
	  The minimum number of bytes that triggers entropy generation for
	  thread mode consumers. The hardware will start generating new entropy
	  data when the available bytes in the buffer fall below this threshold
	  value.

endif # ENTROPY_MITHRIL_TRNG
```

## drivers/gpio/Kconfig.mithril
```kconfig
# Copyright (c) 2025 Yusuf Yamak <yamakyusuf@gmail.com>
# SPDX-License-Identifier: Apache-2.0

config GPIO_MITHRIL
	bool "Mithril GPIO driver"
	default y
	help
	  Enable Mithril GPIO driver.
```

## drivers/serial/Kconfig.mithril
```kconfig
# Copyright (c) 2025 Yusuf Yamak <yamakyusuf@gmail.com>
# SPDX-License-Identifier: Apache-2.0

config UART_MITHRIL
	bool "Mithril serial driver"
	default y
	select SERIAL_HAS_DRIVER
	select SERIAL_SUPPORT_INTERRUPT
	help
	  This option enables Mitril serial driver.
```

## drivers/spi/Kconfig.mithril
```kconfig
config SPI_MITHRIL
	bool "Mithril SPI controller driver"
	default y
	depends on DT_HAS_MITHRIL_SPI_ENABLED
	select USE_MITHRIL_HAL_SPI
	help
	  Enable the SPI peripherals on Mithril
```

## dts/bindings/crypto/mithril,dsee-hash.yaml
```yaml
# Copyright (c) 2025, Yusuf Yamak <yamakyusuf@gmail.com>
# SPDX-License-Identifier: Apache-2.0

description: Mithril DSEE Hash accelerator.

compatible: "mithril,dsee-hash"

include: base.yaml

properties:
  reg:
    required: true

  interrupts:
    required: true
```

## dts/bindings/gpio/mithril,gpio.yaml
```yaml
# Copyright (c) 2025 Yusuf Yamak <yamakyusuf@gmail.com>
# SPDX-License-Identifier: Apache-2.0

description: Mİthril GPIO

compatible: "mithril,gpio"

include: [gpio-controller.yaml, base.yaml]

properties:
  port-is-output:
    type: boolean
    description: Indicates if the port is an output port

  reg:
    required: true

  ngpios:
    required: true

  "#gpio-cells":
    const: 2

gpio-cells:
  - pin
  - flags
```

## dts/bindings/rng/mithril-trng.yaml
```yaml
description: Mithril True Random Number Generator (TRNG) Based On NeoTrng

compatible: "mithril-trng"

include: base.yaml

properties:
  reg:
    required: true
  interrupts:
    required: true
```

## dts/bindings/serial/mithril,uart.yaml
```yaml
# Copyright (c) 2025 Yusuf Yamak <yamakyusuf@gmail.com>
# SPDX-License-Identifier: Apache-2.0

description: Mithril UART

compatible: "mithril,uart"

include: uart-controller.yaml

properties:
  interrupts:
    required: true
```

## dts/bindings/spi/mithril,spi.yaml
```yaml
# Copyright (c) 2025 Yusuf Yamak <yamakyusuf@gmail.com>
# SPDX-License-Identifier: Apache-2.0

description: Mithril SPI

compatible: "mithril,spi"

include: spi-controller.yaml

properties:
  reg:
    required: true
  cs-gpios:
    required: true
```

## dts/bindings/timer/mithril,machine-timer.yaml
```yaml
# Copyright (c) 2025 Yusuf Yamak <yamakyusuf@gmail.com>
# SPDX-License-Identifier: Apache-2.0

description: Mithril Machine Timer

compatible: "mithril,machine-timer"

include: base.yaml

properties:
  reg:
    required: true

  interrupts:
    required: true
```

## modules/Kconfig.mithril
```kconfig
config HAS_MITHRIL_HAL
	bool

if HAS_MITHRIL_HAL

config USE_MITHRIL_HAL_DSEE_HASH
	bool
    help
        Enable Mithril HAL DSEE HASH module driver

config USE_MITHRIL_HAL_UART
	bool
    help
        Enable Mithril HAL UART module driver

config USE_MITHRIL_HAL_TIMER
	bool
    help
        Enable Mithril HAL TIMER module driver

config USE_MITHRIL_HAL_GPIO
	bool
    help
        Enable Mithril HAL GPIO module driver

config USE_MITHRIL_HAL_SPI
	bool
    help
        Enable Mithril HAL SPI module driver

config USE_MITHRIL_HAL_TRNG
	bool
    help
        Enable Mithril HAL TRNG module driver

endif # HAS_MITHRIL_HAL
```

## soc/mithril/Kconfig.defconfig
```kconfig
if SOC_MITHRIL

config SYS_CLOCK_HW_CYCLES_PER_SEC
	default 50000000

config NUM_IRQS
	default 32

config INSTR_MEM_BASE_ADDRESS
	default 0x1000000

config DATA_MEM_BASE_ADDRESS
	default 0x2000000

config XIP
    default n

endif # SOC_MITHRIL
```

## soc/mithril/Kconfig.soc
```kconfig
config SOC_MITHRIL
	bool
	help
	  Mithril system implementation

config RISCV_XPAC_RET
	bool "Enable XPAC return address protection"
	default y
	depends on SOC_MITHRIL && RISCV_ISA_EXT_XPAC
	help
	  Enables -mxpac-ret compiler flag for Mithril's XPAC-based return
	  address protection. This adds automatic PAC store and load to
	  function prologues and epilogues.

config RISCV_LPAD
	bool "Enable Landing Pad (LPAD) for forward-edge CFI"
	default y
	depends on SOC_MITHRIL && RISCV_ISA_EXT_ZICFILP
	help
	  Enables -mlpad-func compiler flag for Mithril's Zicfilp-based
	  landing pad protection. This adds lpad instructions at function
	  entries to protect against forward-edge control-flow attacks (JOP).

config INSTR_MEM_SIZE
	int "Mithril Instruction Memory Size in kB"
	help
	  This option specifies the size of the instruction memory size in kB.

config INSTR_MEM_BASE_ADDRESS
	hex "Mithril Instruction Memory Base Address"
	default 0x1000000
	help
	  This option specifies the base address of Mihtril's instruction memory

config DATA_MEM_SIZE
	int "Mithril Data Memory Size in kB"
	help
	  This option specifies the size of the data memory size in kB.

config DATA_MEM_BASE_ADDRESS
	hex "Mithril Data Memory Base Address"
	default 0x2000000
	help
	  This option specifies the base address of Mihtril's data memory

config BOOT_ARGS_SIZE
	int "Boot Arguments Size in bytes"
	default 256
	help
	  This option specifies the size of the boot arguments in bytes.

config SOC
	default "mithril" if SOC_MITHRIL
```
