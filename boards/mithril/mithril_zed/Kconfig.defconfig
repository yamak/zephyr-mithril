## boards/mithril/mithril_zed/mithril_zed_defconfig
```kconfig
CONFIG_CONSOLE=y
CONFIG_SERIAL=y
CONFIG_UART_CONSOLE=y
CONFIG_GPIO=y
CONFIG_CLOCK_CONTROL=n
CONFIG_HEAP_MEM_POOL_SIZE=4096
CONFIG_XIP=n
CONFIG_SRAM_SIZE=200
CONFIG_INSTR_MEM_SIZE=200
```

## soc/mithril/mithril/Kconfig
```kconfig
config SOC_MITHRIL
	select RISCV
	select ATOMIC_OPERATIONS_C
	select RISCV_ISA_RV32I
	select RISCV_ISA_EXT_M
	select RISCV_ISA_EXT_C
	select RISCV_PRIVILEGED
	select RISCV_VECTORED_MODE
	select RISCV_SOC_INTERRUPT_INIT
	select INCLUDE_RESET_VECTOR
	select HAS_MITHRIL_HAL
	
	
```

## soc/mithril/mithril/Kconfig.defconfig
```kconfig
if SOC_MITHRIL

config SYS_CLOCK_HW_CYCLES_PER_SEC
	default 50000000

config NUM_IRQS
	default 15

config INSTR_MEM_SIZE 
	default 200
	
config INSTR_MEM_BASE_ADDRESS
	default 0x1000000

config FLASH_BASE_ADDRESS
	default 0x1000000

config FLASH_SIZE
	default 200

config XIP
	default n
endif # SOC_MITHRIL
```

## soc/mithril/mithril/Kconfig.soc
```kconfig
# Copyright (c) 2018 - 2019 Antmicro <www.antmicro.com>
# SPDX-License-Identifier: Apache-2.0

config SOC_MITHRIL
	bool
	help
	  Mithril system implementation

config INSTR_MEM_SIZE
	int "Mithril Instruction Memory Size in kB"
	help
	  This option specifies the size of the instruction memory size in kB.

config INSTR_MEM_BASE_ADDRESS
	hex "Mithril Instruction Memory Base Address"
	default 0x1000000
	help
	  This option specifies the base address of Mihtril's instruction memory

config SOC
	default "mithril" if SOC_MITHRIL
```
